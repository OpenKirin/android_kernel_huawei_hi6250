/* DO NOT EDIT - Automatically generated by python */
/ {
		SCUDLGB_3240_200k_4400:SCUDLGB_3240_200k_4400 {
			fcc = <3240>;
			default_rbatt_mohm = <100>;
			id_identify_min = <2786>;
			id_identify_max = <3312>;
			id_voltage_min = <2941>;
			id_voltage_max = <3167>;
			vbat_max = <4400>;
			temp_para = 
						"-32767","0","-1","0","4100","0",
						"0","5","-1","324","4400","0",
						"5","10","-1","972","4400","3",
						"10","45","-1","-1","4400","3",
						"45","50","-1","1134","4400","3",
						"50","32767","-1","0","4400","0";
			vbat_para = 
						"-32767","3400","-1","820","0",
						"3400","32767","-1","-1","0";
			segment_para = 
						"-32767","4150","3240","4208","50",
						"4150","4450","2268","4400","0";
			batt_brand = "SCUDLGB";
			fcc_temp = <3350 3358 3359 3385 3358 3516>;
			fcc_sf_x = <0 100 200 300 400 500>;
			fcc_sf_y = <100 96 94 92 90 88>;
			fcc_sf_cols = <6>;
			pc_sf_rows = <1>;
			pc_sf_cols = <1>;
			pc_sf_row_entries = <0>;
			pc_sf_percent = <100>;
			pc_sf_sf = <100>;
			rbatt_sf_rows = <28>;
			rbatt_sf_cols = <6>;
			rbatt_sf_percent = <100 95 90 85 80 75 70 65 60 55 50 45 40 35 30 25 20 15 10 9 8 7 6 5 4 3 2 1>;
			rbatt_sf_sf = <
			               2150 1126 344 108 80 69
			               2142 1125 344 108 81 69
			               1930 1105 353 110 82 69
			               1798 1068 360 113 82 70
			               1751 1048 375 116 84 71
			               1652 1036 394 123 87 73
			               1545 906 397 133 91 75
			               1542 899 364 145 98 80
			               1522 888 351 154 107 83
			               1519 864 330 129 100 73
			               1565 865 320 108 81 69
			               1637 905 318 107 81 71
			               1727 965 319 110 83 73
			               1832 1043 327 113 87 75
			               1958 1143 348 113 85 68
			               2114 1274 374 108 80 68
			               2317 1454 419 108 80 69
			               2603 1678 508 112 82 70
			               5762 1922 418 109 82 74
			               6600 2268 454 111 81 76
			               7408 2704 489 111 82 121
			               8141 3187 527 116 83 166
			               8781 3725 639 127 85 211
			               9386 4347 829 174 87 256
			               10001 4940 993 314 104 302
			               10651 5611 1326 375 217 347
			               10976 5796 1627 189 97 392
			               12268 6790 1573 252 117 437
			              >;
			pc_temp_ocv_rows = <29>;
			pc_temp_ocv_cols = <6>;
			pc_temp_ocv_percent = <100 95 90 85 80 75 70 65 60 55 50 45 40 35 30 25 20 15 10 9 8 7 6 5 4 3 2 1>;
			pc_temp_ocv_ocv = <
			                   4383 4381 4381 4374 4365 4359
			                   4270 4286 4295 4305 4295 4285
			                   4198 4220 4234 4246 4235 4223
			                   4138 4159 4178 4188 4178 4163
			                   4092 4107 4125 4133 4123 4106
			                   4018 4055 4076 4080 4070 4052
			                   3938 3966 4006 4030 4022 4003
			                   3898 3925 3951 3977 3978 3959
			                   3860 3887 3913 3939 3936 3913
			                   3828 3849 3872 3889 3888 3864
			                   3808 3818 3839 3849 3847 3831
			                   3794 3800 3813 3824 3822 3808
			                   3783 3789 3794 3804 3803 3789
			                   3773 3779 3782 3788 3787 3773
			                   3761 3768 3774 3774 3771 3746
			                   3749 3754 3763 3758 3751 3722
			                   3733 3737 3747 3740 3732 3697
			                   3716 3721 3721 3712 3706 3669
			                   3682 3693 3696 3688 3680 3647
			                   3672 3686 3693 3686 3679 3612
			                   3661 3680 3689 3684 3678 3566
			                   3649 3672 3682 3681 3675 3521
			                   3635 3661 3674 3673 3669 3475
			                   3619 3645 3661 3652 3653 3429
			                   3597 3619 3634 3619 3617 3383
			                   3566 3582 3593 3574 3572 3337
			                   3487 3495 3534 3497 3500 3292
			                   3379 3389 3417 3381 3394 3246
			                   3200 3200 3200 3200 3200 3200
			                  >;
			vol_dec1=  <50>;
			pc_temp_ocv_ocv1 = <
			                   4333 4331 4331 4324 4315 4309
			                   4240 4253 4262 4264 4254 4245
			                   4173 4191 4205 4208 4198 4186
			                   4122 4135 4151 4153 4144 4130
			                   4067 4090 4105 4101 4092 4076
			                   3988 4015 4045 4055 4044 4026
			                   3926 3951 3981 3998 3999 3981
			                   3887 3913 3937 3963 3959 3940
			                   3850 3875 3898 3916 3916 3894
			                   3822 3838 3861 3869 3869 3849
			                   3805 3812 3831 3839 3837 3823
			                   3792 3797 3808 3817 3815 3802
			                   3781 3786 3791 3799 3798 3785
			                   3771 3777 3780 3784 3784 3767
			                   3760 3766 3773 3771 3766 3741
			                   3747 3752 3761 3755 3748 3719
			                   3732 3735 3745 3738 3729 3693
			                   3714 3720 3719 3709 3702 3668
			                   3680 3691 3695 3687 3680 3636
			                   3670 3685 3692 3686 3679 3598
			                   3659 3679 3688 3684 3677 3554
			                   3647 3671 3681 3680 3674 3510
			                   3634 3659 3673 3670 3668 3466
			                   3617 3643 3659 3647 3649 3421
			                   3595 3616 3630 3614 3611 3377
			                   3563 3579 3590 3569 3567 3333
			                   3483 3490 3528 3490 3493 3289
			                   3376 3385 3412 3377 3388 3244
			                   3200 3200 3200 3200 3200 3200
			                  >;
			vol_dec2=  <200>;
			pc_temp_ocv_ocv2 = <
			                   4183 4181 4181 4174 4165 4159
			                   4150 4161 4153 4144 4135 4128
			                   4114 4112 4122 4099 4092 4083
			                   4058 4076 4079 4059 4049 4037
			                   3982 3988 4017 4010 4008 3996
			                   3925 3942 3961 3972 3972 3958
			                   3890 3908 3929 3938 3936 3919
			                   3855 3873 3892 3894 3895 3876
			                   3827 3839 3859 3856 3855 3842
			                   3809 3815 3832 3833 3831 3819
			                   3796 3800 3810 3814 3813 3801
			                   3785 3789 3794 3799 3798 3786
			                   3776 3780 3783 3786 3785 3771
			                   3766 3771 3776 3774 3770 3747
			                   3755 3760 3768 3761 3754 3726
			                   3743 3745 3755 3745 3737 3708
			                   3728 3730 3737 3725 3719 3679
			                   3711 3716 3711 3697 3691 3666
			                   3673 3686 3692 3686 3679 3597
			                   3664 3680 3689 3684 3677 3557
			                   3653 3674 3683 3680 3674 3518
			                   3641 3664 3676 3673 3669 3478
			                   3628 3651 3666 3656 3655 3438
			                   3611 3633 3646 3629 3628 3398
			                   3589 3605 3616 3595 3592 3359
			                   3556 3558 3574 3546 3543 3319
			                   3470 3474 3509 3468 3471 3279
			                   3369 3371 3397 3363 3369 3240
			                   3200 3200 3200 3200 3200 3200
			                  >;
		};
};

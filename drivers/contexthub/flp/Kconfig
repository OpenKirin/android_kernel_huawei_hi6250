## drivers/contexthub/flp/Kconfig
```kconfig
#
# FLP driver configuration
#

menu "HISI FLP configuration"

config HISI_FLP
	bool "HISI FLP support"
	depends on  INPUTHUB
	default n
	---help---
	  Enable support for FLP driver

endmenu
```

## drivers/devkit/tpkit/hostprocessing/Kconfig
```kconfig
#
# huawei hostprocessing ts driver configuration
#

menuconfig JDI_HOST_TS_KIT
	bool "JDI_HOST ts drivers"
	default n
	help
	  If you say yes here you get support for jdi hostprocessing ts touchscreen.

menuconfig HUAWEI_THP
	bool "HUAWEI thp core drivers"
	default n
	help
	  If you say yes here you get support for core capacity hostprocessing touchscreen.

menuconfig HUAWEI_THP_NOVATECH
	bool "Novatech thp drivers"
	default n
	help
	  If you say yes here you get support for novatech hostprocessing touchscreen.
```

## drivers/devkit/tpkit/panel/gt1x/Kconfig
```kconfig
#
# huawei touchscreen driver configuration
#

menuconfig GOODIX_GT1X_TS_KIT
	bool "TS_KIT goodix GT1X drivers"
	default n
	help
	  If you say yes here you get support for huawei touchscreen.
```

## drivers/hisi/mntn/dmsspt/Kconfig
```kconfig
config HISI_DMSS_PT
    bool "dmss pattern trace module support"
    depends on HISI_DEBUG_FS
    default n
    help
      Say yes here to support the dmss pattern trace module.
```

## drivers/hisi/mntn/pimon/Kconfig
```kconfig
config HISI_PIMON_MNTN
    bool "pimon mntn module support"
    default n
    help
      Say yes here to support the pimon mntn module.
```
